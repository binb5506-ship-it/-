#include "Ultrasound.h"
#include "intrins.h"

/* TX 接触发(Trig)引脚，RX 接回波(Echo)引脚
 * 原来 US_TX 写成 P0^0，引脚错误，应为 P1^0 */
sbit US_TX = P1^0;  /* 触发引脚 → P1.0 */
sbit US_RX = P1^1;  /* 回波引脚 → P1.1 */


/* =========================================================
 * 12us 延时（@12.000MHz 校准）
 * 用于产生精确的 40kHz 触发脉冲
 * ========================================================= */
void Delay12us(void)    //@12.000MHz
{
    unsigned char data i;

    _nop_();
    i = 3;
    while(--i);
}


/* =========================================================
 * 发送触发脉冲（8 个 40kHz 方波）
 *   关中断保证时序准确，发完恢复中断
 * ========================================================= */
void Ultra_Wave_Init()
{
    unsigned char i;
    EA = 0;             /* 关中断，防止定时被打断 */
    for(i = 0; i < 8; i++)
    {
        US_TX = 1;
        Delay12us();
        US_TX = 0;
        Delay12us();
    }
    EA = 1;             /* 恢复中断 */
}


/* =========================================================
 * 测量距离
 *   原理：发出超声波后，用 PCA 计时器记录回波高电平持续时间
 *         距离(cm) = 时间(us) × 0.017
 *   返回值：距离（cm），超时或无回波返回 0
 * ========================================================= */
unsigned char Ultra_Wave_Data()
{
    unsigned int time;

    CMOD = 0x00;        /* PCA 时钟源选系统时钟/12，1us 计一次 */
    CH = CL = 0;        /* 清零 PCA 计数器 */

    Ultra_Wave_Init();  /* 发送触发脉冲，原来忘记调用！没有触发就不会有回波 */

    CR = 1;             /* 启动 PCA 计数器 */

    /* 等待回波结束（US_RX 变低）或计数溢出（CF=1 超时）
     * 注意：while 条件后面必须有分号，否则 CR=0 变成循环体，
     *       计数器被立即停止，无法正常计时 */
    while((US_RX == 1) && (CF == 0));

    CR = 0;             /* 停止计数器 */

    if(CF == 0)         /* 正常收到回波（未溢出）*/
    {
        time = CH << 8 | CL;        /* 读取 16 位计时值（单位 us）*/
        return (time * 0.017);      /* 换算为厘米 */
    }
    else                /* 计时溢出，目标太远或无回波 */
    {
        CF = 0;         /* 清除溢出标志，为下次测量准备 */
        return 0;
    }
}
